## externals/configs/odroidc4_release_nfs_defconfig
```kconfig
BR2_aarch64=y
BR2_KERNEL_HEADERS_6_6=y
BR2_PACKAGE_GLIBC_UTILS=y
BR2_TOOLCHAIN_BUILDROOT_CXX=y
BR2_PACKAGE_HOST_GDB=y
BR2_WGET="wget --passive-ftp -nd -t 3 --no-check-certificate"
BR2_SVN="svn"
BR2_OPTIMIZE_S=y
BR2_SSP_REGULAR=y
BR2_RELRO_NONE=y
BR2_FORTIFY_SOURCE_NONE=y
BR2_ROOTFS_DEVICE_CREATION_DYNAMIC_EUDEV=y
BR2_SYSTEM_DHCP="eth0"
BR2_ROOTFS_OVERLAY="$(BR2_EXTERNAL_CONTINENTAL_PATH)/board/hardkernel/odroidc4/rootfs/"
BR2_ROOTFS_POST_IMAGE_SCRIPT="$(BR2_EXTERNAL_CONTINENTAL_PATH)/board/hardkernel/odroidc4/post-image.sh"
BR2_LINUX_KERNEL=y
BR2_LINUX_KERNEL_CUSTOM_GIT=y
BR2_LINUX_KERNEL_CUSTOM_REPO_URL="https://github.com/hardkernel/linux.git"
BR2_LINUX_KERNEL_CUSTOM_REPO_VERSION="odroid-6.6.y"
BR2_LINUX_KERNEL_USE_CUSTOM_CONFIG=y
BR2_LINUX_KERNEL_CUSTOM_CONFIG_FILE="$(BR2_EXTERNAL_CONTINENTAL_PATH)/board/hardkernel/odroidc4/linux_odroid_nfs_defconfig"
BR2_LINUX_KERNEL_CUSTOM_LOGO_PATH="$(BR2_EXTERNAL_CONTINENTAL_PATH)/board/hardkernel/odroidc4/solar-system-planet-collage_23-2150188972.jpg"
BR2_LINUX_KERNEL_DTS_SUPPORT=y
BR2_LINUX_KERNEL_INTREE_DTS_NAME="amlogic/meson64_odroidc4"
BR2_PACKAGE_BUSYBOX_SHOW_OTHERS=y
BR2_PACKAGE_ALSA_UTILS=y
BR2_PACKAGE_ALSA_UTILS_ALSACONF=y
BR2_PACKAGE_ALSA_UTILS_ALSALOOP=y
BR2_PACKAGE_ALSA_UTILS_ALSATPLG=y
BR2_PACKAGE_ALSA_UTILS_AMIXER=y
BR2_PACKAGE_ALSA_UTILS_APLAY=y
BR2_PACKAGE_ALSA_UTILS_BAT=y
BR2_PACKAGE_ALSA_UTILS_IECSET=y
BR2_PACKAGE_ALSA_UTILS_SPEAKER_TEST=y
BR2_PACKAGE_FFMPEG_FFPLAY=y
BR2_PACKAGE_GSTREAMER1_CHECK=y
BR2_PACKAGE_GST1_PLUGINS_BASE_PLUGIN_SUBPARSE=y
BR2_PACKAGE_GST1_PLUGINS_BASE_PLUGIN_ALSA=y
BR2_PACKAGE_GST1_PLUGINS_BASE_PLUGIN_OGG=y
BR2_PACKAGE_GST1_PLUGINS_GOOD=y
BR2_PACKAGE_GST1_PLUGINS_GOOD_PLUGIN_ALPHA=y
BR2_PACKAGE_GST1_PLUGINS_GOOD_PLUGIN_APETAG=y
BR2_PACKAGE_GST1_PLUGINS_GOOD_PLUGIN_AUDIOPARSERS=y
BR2_PACKAGE_GST1_PLUGINS_GOOD_PLUGIN_AUPARSE=y
BR2_PACKAGE_GST1_PLUGINS_GOOD_PLUGIN_AUTODETECT=y
BR2_PACKAGE_GST1_PLUGINS_GOOD_PLUGIN_DEINTERLACE=y
BR2_PACKAGE_GST1_PLUGINS_GOOD_PLUGIN_FLV=y
BR2_PACKAGE_GST1_PLUGINS_GOOD_PLUGIN_ICYDEMUX=y
BR2_PACKAGE_GST1_PLUGINS_GOOD_PLUGIN_ID3DEMUX=y
BR2_PACKAGE_GST1_PLUGINS_GOOD_PLUGIN_MATROSKA=y
BR2_PACKAGE_GST1_PLUGINS_GOOD_PLUGIN_RTP=y
BR2_PACKAGE_GST1_PLUGINS_GOOD_PLUGIN_RTPMANAGER=y
BR2_PACKAGE_GST1_PLUGINS_GOOD_PLUGIN_RTSP=y
BR2_PACKAGE_GST1_PLUGINS_GOOD_PLUGIN_UDP=y
BR2_PACKAGE_GST1_PLUGINS_GOOD_PLUGIN_VIDEOFILTER=y
BR2_PACKAGE_GST1_PLUGINS_GOOD_PLUGIN_MPG123=y
BR2_PACKAGE_GST1_PLUGINS_GOOD_PLUGIN_V4L2=y
BR2_PACKAGE_GST1_PLUGINS_GOOD_PLUGIN_V4L2_PROBE=y
BR2_PACKAGE_GST1_PLUGINS_GOOD_PLUGIN_PULSE=y
BR2_PACKAGE_GST1_PLUGINS_GOOD_PLUGIN_SOUPHTTPSRC=y
BR2_PACKAGE_GST1_PLUGINS_BAD=y
BR2_PACKAGE_GST1_PLUGINS_BAD_PLUGIN_AIFF=y
BR2_PACKAGE_GST1_PLUGINS_BAD_PLUGIN_AUTOCONVERT=y
BR2_PACKAGE_GST1_PLUGINS_BAD_PLUGIN_ID3TAG=y
BR2_PACKAGE_GST1_PLUGINS_BAD_PLUGIN_INTERLACE=y
BR2_PACKAGE_GST1_PLUGINS_BAD_PLUGIN_IVFPARSE=y
BR2_PACKAGE_GST1_PLUGINS_BAD_PLUGIN_MPEGDEMUX=y
BR2_PACKAGE_GST1_PLUGINS_BAD_PLUGIN_MPEGTSDEMUX=y
BR2_PACKAGE_GST1_PLUGINS_BAD_PLUGIN_PCAPPARSE=y
BR2_PACKAGE_GST1_PLUGINS_BAD_PLUGIN_RAWPARSE=y
BR2_PACKAGE_GST1_PLUGINS_BAD_PLUGIN_SMOOTH=y
BR2_PACKAGE_GST1_PLUGINS_BAD_PLUGIN_VIDEOFILTERS=y
BR2_PACKAGE_GST1_PLUGINS_BAD_PLUGIN_VIDEOPARSERS=y
BR2_PACKAGE_GST1_PLUGINS_BAD_PLUGIN_BZ2=y
BR2_PACKAGE_GST1_PLUGINS_BAD_PLUGIN_CURL=y
BR2_PACKAGE_GST1_PLUGINS_BAD_PLUGIN_DASH=y
BR2_PACKAGE_GST1_PLUGINS_BAD_PLUGIN_HLS=y
BR2_PACKAGE_GST1_PLUGINS_BAD_PLUGIN_V4L2CODECS=y
BR2_PACKAGE_GST1_PLUGINS_UGLY=y
BR2_PACKAGE_GST1_PLUGINS_UGLY_PLUGIN_ASFDEMUX=y
BR2_PACKAGE_GST1_PLUGINS_UGLY_PLUGIN_REALMEDIA=y
BR2_PACKAGE_GST1_LIBAV=y
BR2_PACKAGE_WAVPACK=y
BR2_PACKAGE_DHRYSTONE=y
BR2_PACKAGE_IOZONE=y
BR2_PACKAGE_MEMSTAT=y
BR2_PACKAGE_RAMSMP=y
BR2_PACKAGE_RAMSPEED=y
BR2_PACKAGE_WHETSTONE=y
BR2_PACKAGE_BINUTILS=y
BR2_PACKAGE_FLEX=y
BR2_PACKAGE_DOSFSTOOLS=y
BR2_PACKAGE_E2FSPROGS=y
BR2_PACKAGE_NTFS_3G=y
BR2_PACKAGE_LIBERATION=y
BR2_PACKAGE_KMSCUBE=y
BR2_PACKAGE_KMSCUBE_GSTREAMER=y
BR2_PACKAGE_MESA3D_DEMOS=y
BR2_PACKAGE_DIRECTFB=y
BR2_PACKAGE_DIRECTFB_EXAMPLES=y
BR2_PACKAGE_FB_TEST_APP=y
BR2_PACKAGE_FBDUMP=y
BR2_PACKAGE_FBGRAB=y
BR2_PACKAGE_FBSET=y
BR2_PACKAGE_MESA3D=y
BR2_PACKAGE_MESA3D_GALLIUM_DRIVER_PANFROST=y
BR2_PACKAGE_MESA3D_GALLIUM_DRIVER_SWRAST=y
BR2_PACKAGE_MESA3D_OPENGL_EGL=y
BR2_PACKAGE_MESA3D_OPENGL_ES=y
BR2_PACKAGE_XKEYBOARD_CONFIG=y
BR2_PACKAGE_DBUS=y
BR2_PACKAGE_EDID_DECODE=y
BR2_PACKAGE_KBD=y
BR2_PACKAGE_MEMTESTER=y
BR2_PACKAGE_LIBID3TAG=y
BR2_PACKAGE_LIBMAD=y
BR2_PACKAGE_LIBSAMPLERATE=y
BR2_PACKAGE_OPENSSL=y
BR2_PACKAGE_SQLITE_ENABLE_COLUMN_METADATA=y
BR2_PACKAGE_LIBCONFIG=y
BR2_PACKAGE_CAIRO_SCRIPT=y
BR2_PACKAGE_LIBJPEG=y
BR2_PACKAGE_WAYLAND=y
BR2_PACKAGE_WAYLAND_UTILS=y
BR2_PACKAGE_WAYLANDPP=y
BR2_PACKAGE_LIBINPUT=y
BR2_PACKAGE_LIBUSB=y
BR2_PACKAGE_CJSON=y
BR2_PACKAGE_LIBXSLT=y
BR2_PACKAGE_LIBSOUP=y
BR2_PACKAGE_FFTW=y
BR2_PACKAGE_FFTW_FAST=y
BR2_PACKAGE_LIBEVENT=y
BR2_PACKAGE_PCRE=y
BR2_PACKAGE_PCRE_16=y
BR2_PACKAGE_PCRE_UCP=y
BR2_PACKAGE_POPT=y
BR2_PACKAGE_IPERF3=y
BR2_PACKAGE_IW=y
BR2_PACKAGE_NETPLUG=y
BR2_PACKAGE_WPA_SUPPLICANT=y
BR2_PACKAGE_WPA_SUPPLICANT_CLI=y
BR2_PACKAGE_ATTR=y
BR2_PACKAGE_HTOP=y
BR2_PACKAGE_KEYUTILS=y
BR2_PACKAGE_UTIL_LINUX_BINARIES=y
BR2_PACKAGE_VIM=y
BR2_TARGET_ROOTFS_CPIO=y
BR2_TARGET_ROOTFS_CPIO_UIMAGE=y
BR2_TARGET_ROOTFS_EXT2=y
BR2_TARGET_ROOTFS_EXT2_4=y
BR2_TARGET_ROOTFS_EXT2_LABEL=""
BR2_TARGET_ROOTFS_EXT2_SIZE="640M"
BR2_TARGET_ROOTFS_EXT2_RESBLKS=0
BR2_TARGET_UBOOT_BUILD_SYSTEM_KCONFIG=y
BR2_TARGET_UBOOT_CUSTOM_GIT=y
BR2_TARGET_UBOOT_CUSTOM_REPO_URL="https://github.com/u-boot/u-boot.git"
BR2_TARGET_UBOOT_CUSTOM_REPO_VERSION="v2024.04-rc5"
BR2_TARGET_UBOOT_BOARD_DEFCONFIG="odroid-c4"
BR2_TARGET_UBOOT_NEEDS_DTC=y
BR2_PACKAGE_HOST_AMLOGIC_BOOT_FIP=y
BR2_PACKAGE_HOST_AMLOGIC_BOOT_FIP_DEVICE="odroid-c4"
BR2_PACKAGE_HOST_DOSFSTOOLS=y
BR2_PACKAGE_HOST_GENEXT2FS=y
BR2_PACKAGE_HOST_GENIMAGE=y
BR2_PACKAGE_HOST_MESON_TOOLS=y
BR2_PACKAGE_HOST_MTOOLS=y
BR2_PACKAGE_HOST_UBOOT_TOOLS_ENVIMAGE=y
BR2_PACKAGE_HOST_UBOOT_TOOLS_ENVIMAGE_SOURCE="/mnt/SSD/Odroid_C4/BuildRoot_Ext/externals/board/hardkernel/odroidc4/uboot_env.txt"
BR2_PACKAGE_HOST_UBOOT_TOOLS_ENVIMAGE_SIZE="0x2000"
BR2_PACKAGE_ODROID_FIRMWARE=y
BR2_TARGET_ROOTFS_NFS=y
BR2_TARGET_ROOTFS_NFS_PATH="$(HOME)/nfs/odroid_c4"
```

## externals/fs/Config.in
```kconfig
menu "File systems"

source "$BR2_EXTERNAL_CONTINENTAL_PATH/fs/nfs/Config.in"

endmenu
```

## externals/fs/nfs/Config.in
```kconfig
config BR2_TARGET_ROOTFS_NFS
	bool "nfs root filesystem"
	help
	  Build a nfs root filesystem
config BR2_TARGET_ROOTFS_NFS_PATH
	string "board to configure for"
	depends on BR2_TARGET_ROOTFS_NFS
	default "$HOME/nfs"
	help
	  Specify the path where the nfs will be installed.
	  add this path to exports params in NFS server file
```

## externals/package/Config.in
```kconfig
source "$BR2_EXTERNAL_CONTINENTAL_PATH/package/boot_image_generation/Config.in"
source "$BR2_EXTERNAL_CONTINENTAL_PATH/package/mmc-tools/Config.in"
source "$BR2_EXTERNAL_CONTINENTAL_PATH/package/pfe/Config.in"
source "$BR2_EXTERNAL_CONTINENTAL_PATH/package/odroid-firmware/Config.in"
```

## externals/package/boot_image_generation/Config.in
```kconfig
config BR2_PACKAGE_HOST_BOOT_IMAGE_GENERATION
	bool "boot_image_generation engine"
	help
	  boot_image_generation engine for S32G2 HW
```

## externals/package/mmc-tools/Config.in
```kconfig
config BR2_PACKAGE_MMC_TOOLS
	bool "mmc-utils"
	depends on BR2_TOOLCHAIN_HEADERS_AT_LEAST_4_4
	help
	  MMC utils

	  https://git.kernel.org/cgit/linux/kernel/git/cjb/mmc-utils.git


comment "mmc-tools needs a toolchain w/ headers >= 4.4"
	depends on !BR2_TOOLCHAIN_HEADERS_AT_LEAST_4_4
```

## externals/package/multimedia/Config.in
```kconfig
menu "Audio and video applications"
source "$BR2_EXTERNAL_CONTINENTAL_PATH/package/multimedia/alsa-plugins/Config.in"
source "$BR2_EXTERNAL_CONTINENTAL_PATH/package/multimedia/amaudio/Config.in"
source "$BR2_EXTERNAL_CONTINENTAL_PATH/package/multimedia/audiocapture/Config.in"
source "$BR2_EXTERNAL_CONTINENTAL_PATH/package/multimedia/mediasupport/Config.in"
source "$BR2_EXTERNAL_CONTINENTAL_PATH/package/multimedia/dolby_atmos_release/Config.in"

# Gstreamer 0.10.x & Plugins
source "$BR2_EXTERNAL_CONTINENTAL_PATH/package/multimedia/gst-fluendo-mpegdemux/Config.in"
source "$BR2_EXTERNAL_CONTINENTAL_PATH/package/multimedia/gst-aml-plugins/Config.in"
source "$BR2_EXTERNAL_CONTINENTAL_PATH/package/multimedia/gst-aml-plugins1/Config.in"
source "$BR2_EXTERNAL_CONTINENTAL_PATH/package/multimedia/gst-app/Config.in"

source "$BR2_EXTERNAL_CONTINENTAL_PATH/package/multimedia/libplayer/Config.in"
source "$BR2_EXTERNAL_CONTINENTAL_PATH/package/multimedia/wifidisplay/Config.in"
source "$BR2_EXTERNAL_CONTINENTAL_PATH/package/multimedia/test_tool/spdif_in_dd_decoder/Config.in"

# secure video firmware load 
source "$BR2_EXTERNAL_CONTINENTAL_PATH/package/multimedia/secfirmload/Config.in"
# hal audio
source "$BR2_EXTERNAL_CONTINENTAL_PATH/package/multimedia/aml_halaudio/Config.in"
# drm prebuild
source "$BR2_EXTERNAL_CONTINENTAL_PATH/package/multimedia/libmediadrm/Config.in"
endmenu
```

## externals/package/multimedia/libmediadrm/Config.in
```kconfig
menu "Media DRM Prebuilt"
source "$BR2_EXTERNAL_CONTINENTAL_PATH/package/multimedia/libmediadrm/widevine-bin/Config.in"
source "$BR2_EXTERNAL_CONTINENTAL_PATH/package/multimedia/libmediadrm/libsecmem-bin/Config.in"
endmenu
```

## externals/package/odroid-firmware/Config.in
```kconfig
config BR2_PACKAGE_ODROID_FIRMWARE
	bool "odroid-firmware"
	select BR2_TARGET_UBOOT
	help
	  This package extracts from
	  https://github.com/hardkernel/u-boot/tree/odroidc4-v2015.01
	  the pre-built firmware files, as well as the host tool
	  fip_create that are needed to create bootable images for the
	  Odroid C4 platform. See doc/board/amlogic/odroid-c4.rst in
	  upstream U-Boot for more details.

	  https://github.com/hardkernel/u-boot/tree/odroidc4-v2015.01
```

## externals/package/pfe/Config.in
```kconfig
config BR2_PACKAGE_PFE
    bool "PFE_module"
    depends on BR2_LINUX_KERNEL
    help
            Linux Kernel Module for pfe engine
```
