## externals/Config.in
```kconfig
source "$BR2_EXTERNAL_CONTINENTAL_PATH/package/Config.in"
source "$BR2_EXTERNAL_CONTINENTAL_PATH/boot/Config.in"
source "$BR2_EXTERNAL_CONTINENTAL_PATH/fs/Config.in"
```

## externals/board/freescale/common/S32G399/Eval/bsp36.0/uboot/s32g399a_Eval_bsp36_uboot_defconfig
```kconfig
CONFIG_ARM=y
CONFIG_ARCH_S32G3=y
CONFIG_S32CC_HWCONFIG="serdes0:mode=pcie,clock=ext;pcie0:mode=rc;serdes1:mode=xpcs0&xpcs1,clock=ext,fmhz=125;xpcs1_0:speed=2G5"
# CONFIG_SPI_FLASH_BAR is not set
# CONFIG_FSL_PFENG is not set
CONFIG_TARGET_S32G3XXAEVB3=y
CONFIG_SD_BOOT=y
```

## externals/board/freescale/common/S32G399/VC_HPC/bsp36.0/uboot/s32g3xxaevb_emmc_defconfig
```kconfig
CONFIG_ARM=y
CONFIG_ARCH_S32G3=y
CONFIG_CUSTOM_SYS_TEXT_BASE=y
CONFIG_SYS_TEXT_BASE=0xdfaa0000
CONFIG_SYS_LOAD_ADDR=0x80000000
CONFIG_CUSTOM_SYS_DATA_BASE=y
CONFIG_SYS_DATA_BASE=0xdfa00000
CONFIG_S32CC_MAX_DTB_SIZE=0x8000
CONFIG_S32GEN1_HWCONFIG="pcie0:mode=sgmii,clock=int,fmhz=125,xpcs_mode=both;pcie1:mode=sgmii,clock=int,fmhz=125,xpcs_mode=2G5"
CONFIG_EXTRA_KERNEL_BOOT_ARGS="hpe_args=${pfeaddr},${pfe1addr},${pfe2addr}"
CONFIG_ENV_OFFSET=0xa000
CONFIG_ENV_IS_IN_MMC=y
CONFIG_ENV_SIZE=0x1e00
# CONFIG_ENV_IS_IN_SPI_FLASH is not set
CONFIG_NR_DRAM_BANKS=1
CONFIG_TARGET_S32G3XXAEVB=y
CONFIG_TARGET_S32GEN1_HPER_GEN2=y
CONFIG_HPER_GEN2_BOOTLOADER=y
CONFIG_HPER_GEN2_BANK_MGMT=y
CONFIG_ENV_VARS_UBOOT_CONFIG=y
CONFIG_SD_BOOT=y
CONFIG_LOG_DEFAULT_LEVEL=9
CONFIG_DISPLAY_CPUINFO=n
# CONFIG_CMD_EEPROM is not set
# CONFIG_CMD_MD5SUM is not set
# CONFIG_CMD_MEMTEST is not set
# CONFIG_CMD_LZMADEC is not set
# CONFIG_CMD_UNZIP is not set
# CONFIG_CMD_ADC is not set
# CONFIG_CMD_FUSE is not set
# CONFIG_CMD_GPIO is not set
# CONFIG_CMD_I2C is not set
# CONFIG_CMD_LOADB is not set
# CONFIG_CMD_LOADS is not set
# CONFIG_CMD_DHCP is not set
# CONFIG_CMD_EXT2 is not set
# CONFIG_CMD_EXT4 is not set
# CONFIG_CMD_FAT is not set
CONFIG_EFI_PARTITION=y
# CONFIG_ADC is not set
# CONFIG_SARADC_S32CC is not set
# CONFIG_SJA1105 is not set
CONFIG_MMC_HS400_SUPPORT=y
# CONFIG_DM_PMIC_VR5510 is not set
CONFIG_DM_REGULATOR=y
# CONFIG_TIMER is not set
CONFIG_USB=y
CONFIG_GPIO_HOG=y
CONFIG_DM_USB=y
CONFIG_USB_EHCI_HCD=y
CONFIG_USB_ULPI_VIEWPORT=y
CONFIG_USB_ULPI=y
# CONFIG_FS_FAT is not set
# CONFIG_GZIP is not set
# CONFIG_EFI_LOADER is not set
```

## externals/boot/Config.in
```kconfig
menu "Bootloaders"

source "$BR2_EXTERNAL_CONTINENTAL_PATH/boot/conti-bootloader/Config.in"

endmenu
```

## externals/boot/conti-bootloader/Config.in
```kconfig
config BR2_TARGET_CONTI_BOOTLOADER
	bool "CONTI-bootloader"
	help
	  1st level bootloader for Actions Semiconductor CONTI SoC.

	  https://github.com/xapp-le/owl

config BR2_TARGET_CONTI_BOOTLOADER_BOARD
	string "board to configure for"
	depends on BR2_TARGET_CONTI_BOOTLOADER
	default "s32g-procevb-s"
	help
	  Specify the board to configure the bootloader for.
	  This should be the name of a directory under CONTI/boards
	  containing a suitable bootloader.ini file.
```

## externals/configs/freescale_s32g399a_Baseboard_Plus_bsp34_defconfig
```kconfig
BR2_aarch64=y
BR2_ARM_FPU_VFPV3=y
BR2_PACKAGE_HOST_LINUX_HEADERS_CUSTOM_5_10=y
BR2_GCC_VERSION_12_X=y
BR2_TOOLCHAIN_BUILDROOT_CXX=y
BR2_PACKAGE_HOST_GDB=y
BR2_TOOLCHAIN_GLIBC_GCONV_LIBS_COPY=y
BR2_TARGET_GENERIC_HOSTNAME="hpe-penta"
BR2_TARGET_GENERIC_ISSUE="Welcome to hpe-penta"
BR2_ROOTFS_MERGED_USR=y
BR2_SYSTEM_DEFAULT_PATH="/bin:/sbin:/usr/bin:/usr/sbin"
BR2_TARGET_TZ_INFO=y
BR2_LINUX_KERNEL=y
BR2_LINUX_KERNEL_CUSTOM_GIT=y
BR2_LINUX_KERNEL_CUSTOM_REPO_URL="https://github.com/nxp-auto-linux/linux.git"
BR2_LINUX_KERNEL_CUSTOM_REPO_VERSION="bsp34.2-5.10.120-rt"
BR2_LINUX_KERNEL_PATCH="$(BR2_EXTERNAL_CONTINENTAL_PATH)/board/freescale/common/S32G399/bsp34.0/kernel/patches"
BR2_LINUX_KERNEL_USE_CUSTOM_CONFIG=y
BR2_LINUX_KERNEL_CUSTOM_CONFIG_FILE="$(BR2_EXTERNAL_CONTINENTAL_PATH)/board/freescale/common/S32G399/bsp34.0/kernel/s32g399a_evb_hpe_defconfig"
BR2_LINUX_KERNEL_DTS_SUPPORT=y
BR2_LINUX_KERNEL_INTREE_DTS_NAME="continental/xmi_g3_hper_gen2"
BR2_LINUX_KERNEL_DTB_KEEP_DIRNAME=y
BR2_LINUX_KERNEL_NEEDS_HOST_OPENSSL=y
BR2_PACKAGE_BUSYBOX_SHOW_OTHERS=y
BR2_PACKAGE_GDB=y
BR2_PACKAGE_GDB_DEBUGGER=y
BR2_PACKAGE_CPIO=y
BR2_PACKAGE_SQUASHFS=y
BR2_PACKAGE_LIBP11=y
BR2_PACKAGE_LIBSSH=y
BR2_PACKAGE_LIBSSH_SERVER=y
BR2_PACKAGE_LIBSSH2=y
BR2_PACKAGE_LIBOPENSSL_BIN=y
BR2_PACKAGE_LIBOPENSSL_ENGINES=y
BR2_PACKAGE_LIBFUSE=y
BR2_PACKAGE_OPENSC=y
BR2_PACKAGE_EXPAT=y
BR2_PACKAGE_JSON_C=y
BR2_PACKAGE_GTEST=y
BR2_PACKAGE_GTEST_GMOCK=y
BR2_PACKAGE_LIBCAP=y
BR2_PACKAGE_LIBFFI=y
BR2_PACKAGE_HTOP=y
BR2_PACKAGE_KMOD=y
BR2_PACKAGE_KMOD_TOOLS=y
BR2_PACKAGE_UTIL_LINUX=y
BR2_PACKAGE_UTIL_LINUX_AGETTY=y
BR2_PACKAGE_UTIL_LINUX_FSCK=y
BR2_PACKAGE_UTIL_LINUX_MOUNT=y
BR2_TARGET_ROOTFS_EXT2=y
BR2_TARGET_ROOTFS_EXT2_4=y
BR2_TARGET_ROOTFS_EXT2_SIZE="120M"
BR2_TARGET_ROOTFS_SQUASHFS=y
# BR2_TARGET_ROOTFS_TAR is not set
BR2_TARGET_ARM_TRUSTED_FIRMWARE=y
BR2_TARGET_ARM_TRUSTED_FIRMWARE_CUSTOM_GIT=y
BR2_TARGET_ARM_TRUSTED_FIRMWARE_CUSTOM_REPO_URL="https://github.com/nxp-auto-linux/arm-trusted-firmware.git"
BR2_TARGET_ARM_TRUSTED_FIRMWARE_CUSTOM_REPO_VERSION="bsp34.0-2.5"
BR2_TARGET_ARM_TRUSTED_FIRMWARE_PLATFORM="s32g3xxaevb"
BR2_TARGET_ARM_TRUSTED_FIRMWARE_PATCH="$(BR2_EXTERNAL_CONTINENTAL_PATH)/board/freescale/common/S32G399/bsp34.0/atf/patches"
BR2_TARGET_ARM_TRUSTED_FIRMWARE_FIP=y
BR2_TARGET_ARM_TRUSTED_FIRMWARE_UBOOT_AS_BL33=y
BR2_TARGET_ARM_TRUSTED_FIRMWARE_UBOOT_BL33_IMAGE="u-boot-nodtb.bin"
BR2_TARGET_ARM_TRUSTED_FIRMWARE_ADDITIONAL_VARIABLES="S32_USE_LINFLEX_IN_BL31=1 FIP_MEMORY_OFFSET=0x34EC8F00 BL2_BASE=0x34ed0000 HSE_SECBOOT=1 HPER_GEN2_G3=1"
BR2_TARGET_ARM_TRUSTED_FIRMWARE_IMAGES="fip.bin"
BR2_TARGET_ARM_TRUSTED_FIRMWARE_NEEDS_DTC=y
BR2_TARGET_UBOOT=y
BR2_TARGET_UBOOT_BUILD_SYSTEM_KCONFIG=y
BR2_TARGET_UBOOT_CUSTOM_GIT=y
BR2_TARGET_UBOOT_CUSTOM_REPO_URL="https://github.com/nxp-auto-linux/u-boot.git"
BR2_TARGET_UBOOT_CUSTOM_REPO_VERSION="bsp34.0-2020.04"
BR2_TARGET_UBOOT_PATCH="$(BR2_EXTERNAL_CONTINENTAL_PATH)/board/freescale/common/S32G399/bsp34.0/uboot/patches"
BR2_TARGET_UBOOT_BOARD_DEFCONFIG="s32g3_hper_gen2_xmi"
BR2_TARGET_UBOOT_NEEDS_DTC=y
BR2_TARGET_UBOOT_FORMAT_CUSTOM=y
BR2_TARGET_UBOOT_FORMAT_CUSTOM_NAME="u-boot-nodtb.bin"
BR2_TARGET_UBOOT_CUSTOM_MAKEOPTS="-Wl,-O1 -Wl,--allow-shlib-undefined -Wl"
BR2_PACKAGE_HOST_DOSFSTOOLS=y
BR2_PACKAGE_HOST_GENIMAGE=y
BR2_PACKAGE_HOST_IMX_MKIMAGE=y
BR2_PACKAGE_HOST_MTOOLS=y
BR2_PACKAGE_HOST_UBOOT_TOOLS=y
BR2_PACKAGE_HOST_UBOOT_TOOLS_FIT_SUPPORT=y
BR2_PACKAGE_HOST_UBOOT_TOOLS_FIT_SIGNATURE_SUPPORT=y
```

## externals/configs/freescale_s32g399a_Eval_bsp37_defconfig
```kconfig
BR2_aarch64=y
BR2_ARM_FPU_VFPV3=y
BR2_PACKAGE_HOST_LINUX_HEADERS_CUSTOM_5_15=y
BR2_TOOLCHAIN_BUILDROOT_CXX=y
BR2_PACKAGE_HOST_GDB=y
BR2_TOOLCHAIN_GLIBC_GCONV_LIBS_COPY=y
BR2_TARGET_GENERIC_HOSTNAME="hpe-penta"
BR2_TARGET_GENERIC_ISSUE="Welcome to hpe-penta"
BR2_ROOTFS_MERGED_USR=y
BR2_SYSTEM_DEFAULT_PATH="/bin:/sbin:/usr/bin:/usr/sbin"
BR2_TARGET_TZ_INFO=y
BR2_LINUX_KERNEL=y
BR2_LINUX_KERNEL_CUSTOM_GIT=y
BR2_LINUX_KERNEL_CUSTOM_REPO_URL="https://github.com/nxp-auto-linux/linux.git"
BR2_LINUX_KERNEL_CUSTOM_REPO_VERSION="release/bsp36.0_cd-5.15.85-rt"
BR2_LINUX_KERNEL_USE_CUSTOM_CONFIG=y
BR2_LINUX_KERNEL_CUSTOM_CONFIG_FILE="$(BR2_EXTERNAL_CONTINENTAL_PATH)/board/freescale/common/S32G399/bsp36.0/EvalBoard/kernel/linux_bsp36_s32g399_defconfig"
BR2_LINUX_KERNEL_DTS_SUPPORT=y
BR2_LINUX_KERNEL_INTREE_DTS_NAME="freescale/s32g3xxa-evb3"
BR2_LINUX_KERNEL_DTB_KEEP_DIRNAME=y
BR2_LINUX_KERNEL_NEEDS_HOST_OPENSSL=y
BR2_PACKAGE_BUSYBOX_SHOW_OTHERS=y
BR2_PACKAGE_GDB=y
BR2_PACKAGE_GDB_DEBUGGER=y
BR2_PACKAGE_CPIO=y
BR2_PACKAGE_SQUASHFS=y
BR2_PACKAGE_LIBP11=y
BR2_PACKAGE_LIBSSH=y
BR2_PACKAGE_LIBSSH_SERVER=y
BR2_PACKAGE_LIBSSH2=y
BR2_PACKAGE_LIBOPENSSL_BIN=y
BR2_PACKAGE_LIBOPENSSL_ENGINES=y
BR2_PACKAGE_LIBFUSE=y
BR2_PACKAGE_OPENSC=y
BR2_PACKAGE_EXPAT=y
BR2_PACKAGE_JSON_C=y
BR2_PACKAGE_GTEST=y
BR2_PACKAGE_GTEST_GMOCK=y
BR2_PACKAGE_LIBCAP=y
BR2_PACKAGE_LIBFFI=y
BR2_PACKAGE_HTOP=y
BR2_PACKAGE_KMOD=y
BR2_PACKAGE_KMOD_TOOLS=y
BR2_PACKAGE_UTIL_LINUX=y
BR2_PACKAGE_UTIL_LINUX_AGETTY=y
BR2_PACKAGE_UTIL_LINUX_FSCK=y
BR2_PACKAGE_UTIL_LINUX_MOUNT=y
BR2_TARGET_ROOTFS_EXT2=y
BR2_TARGET_ROOTFS_EXT2_4=y
BR2_TARGET_ROOTFS_EXT2_SIZE="120M"
BR2_TARGET_ROOTFS_SQUASHFS=y
# BR2_TARGET_ROOTFS_TAR is not set
BR2_TARGET_ARM_TRUSTED_FIRMWARE=y
BR2_TARGET_ARM_TRUSTED_FIRMWARE_CUSTOM_GIT=y
BR2_TARGET_ARM_TRUSTED_FIRMWARE_CUSTOM_REPO_URL="https://github.com/nxp-auto-linux/arm-trusted-firmware.git"
BR2_TARGET_ARM_TRUSTED_FIRMWARE_CUSTOM_REPO_VERSION="bsp36.0_cd-2.5"
BR2_TARGET_ARM_TRUSTED_FIRMWARE_PLATFORM="s32g3xxaevb3"
BR2_TARGET_ARM_TRUSTED_FIRMWARE_FIP=y
BR2_TARGET_ARM_TRUSTED_FIRMWARE_UBOOT_AS_BL33=y
BR2_TARGET_ARM_TRUSTED_FIRMWARE_UBOOT_BL33_IMAGE="u-boot-nodtb.bin"
BR2_TARGET_ARM_TRUSTED_FIRMWARE_ADDITIONAL_VARIABLES="BL33DIR=/mnt/SSD/VC_HPC/BuildRoot_Ext/output/freescale_s32g399a_Eval_bsp36/build/uboot-bsp36.0_cd-2020.04"
BR2_TARGET_ARM_TRUSTED_FIRMWARE_DEBUG=y
BR2_TARGET_ARM_TRUSTED_FIRMWARE_IMAGES="fip.s32"
BR2_TARGET_ARM_TRUSTED_FIRMWARE_NEEDS_DTC=y
BR2_TARGET_UBOOT=y
BR2_TARGET_UBOOT_BUILD_SYSTEM_KCONFIG=y
BR2_TARGET_UBOOT_CUSTOM_GIT=y
BR2_TARGET_UBOOT_CUSTOM_REPO_URL="https://github.com/nxp-auto-linux/u-boot.git"
BR2_TARGET_UBOOT_CUSTOM_REPO_VERSION="bsp36.0_cd-2020.04"
BR2_TARGET_UBOOT_BOARD_DEFCONFIG="s32g3xxaevb3"
BR2_TARGET_UBOOT_NEEDS_DTC=y
BR2_TARGET_UBOOT_FORMAT_CUSTOM=y
BR2_TARGET_UBOOT_FORMAT_CUSTOM_NAME="u-boot-nodtb.bin"
BR2_TARGET_UBOOT_CUSTOM_MAKEOPTS="-Wl,-O1 -Wl,--allow-shlib-undefined -Wl"
BR2_PACKAGE_HOST_DOSFSTOOLS=y
BR2_PACKAGE_HOST_GENIMAGE=y
BR2_PACKAGE_HOST_IMX_MKIMAGE=y
BR2_PACKAGE_HOST_MTOOLS=y
BR2_PACKAGE_HOST_UBOOT_TOOLS=y
BR2_PACKAGE_HOST_UBOOT_TOOLS_FIT_SUPPORT=y
BR2_PACKAGE_HOST_UBOOT_TOOLS_FIT_SIGNATURE_SUPPORT=y
BR2_PACKAGE_HOST_BOOT_IMAGE_GENERATION=y
BR2_PACKAGE_MMC_TOOLS=y
BR2_TARGET_ROOTFS_NFS=y
BR2_TARGET_ROOTFS_NFS_PATH="/mnt/SSD/nfs/Eval"
```
